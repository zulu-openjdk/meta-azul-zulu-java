## conf/layer.conf
```bitbake
# We have a conf and classes directory, add to BBPATH
BBPATH := "${BBPATH}:${LAYERDIR}"

# We have a packages directory, add to BBFILES
BBFILES := "${BBFILES} ${LAYERDIR}/recipes-*/*/*.bb \
            ${LAYERDIR}/recipes-*/*/*.bbappend"

BBFILE_COLLECTIONS += "azul-zulu-java"
BBFILE_PATTERN_azul-zulu-java := "^${LAYERDIR}/"
BBFILE_PRIORITY_azul-zulu-java = "6"
```
